## config/west.yml
```yaml
manifest:
  remotes:
    - name: zmkfirmware
      url-base: https://github.com/zmkfirmware
  projects:
    - name: zmk
      remote: zmkfirmware
      revision: 489953288a87693248386f6a70a8d6e32152843b # Stand vor dem Pillbug-Fehler
      import: app/west.yml
  self:
    path: config
```

## config/zmk-pointing/Kconfig.pointing
```kconfig
config ZMK_INPUT
    bool "Input event support"

config ZMK_INPUT_MOUSE_PS2
    bool "PS/2 mouse input driver"
    depends on ZMK_INPUT && PS2
    help
      Enable the PS/2 mouse input driver.
```

## config/zmk-pointing/zephyr/Kconfig
```kconfig
menu "Pointing"

config ZMK_INPUT
    bool "Input event support"
    default y

config ZMK_INPUT_MOUSE_PS2
    bool "PS/2 mouse input driver"
    depends on PS2
    default y

config ZMK_INPUT_MOUSE_PS2_SENSITIVITY
    int "Sensitivity"
    default 120

config ZMK_INPUT_MOUSE_PS2_REPORT_INTERVAL
    int "Report Interval"
    default 10

endmenu
```
